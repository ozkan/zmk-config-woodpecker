## config/boards/shields/woodpecker/Kconfig.shield
```kconfig
# Copyright (c) 2023 The ZMK Contributors
# SPDX-License-Identifier: MIT

config SHIELD_WOODPECKER
    def_bool $(shields_list_contains,woodpecker)
```
